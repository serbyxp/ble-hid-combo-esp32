## main/Kconfig.projbuild
```kconfig
menu "Application Wi-Fi Configuration"

config APP_WIFI_SOFTAP_SSID
    string "SoftAP SSID"
    default "HID32"
    help
        SSID broadcast by the device when running in SoftAP mode.

config APP_WIFI_SOFTAP_PASSWORD
    string "SoftAP password"
    default ""
    help
        Password used for the SoftAP. Leave empty to fall back to the
        built-in provisioning password. WPA2 passwords must be at least
        8 characters; shorter strings will start an open SoftAP.

config APP_WIFI_SOFTAP_CHANNEL
    int "SoftAP channel"
    range 1 13
    default 6
    help
        Wi-Fi channel used for the SoftAP.

endmenu
```

## sdkconfig.defaults
```kconfig
# Enable NimBLE and HID
CONFIG_BT_ENABLED=y
CONFIG_BT_NIMBLE_ENABLED=y
CONFIG_BT_NIMBLE_ROLE_PERIPHERAL=y
CONFIG_BT_NIMBLE_MAX_CONNECTIONS=1
CONFIG_BT_NIMBLE_ATT_PREFERRED_MTU=180
CONFIG_BT_NIMBLE_MAX_BONDS=6
CONFIG_BT_NIMBLE_MAX_CCCDS=8

# Classic BT off to save memory
CONFIG_BT_CLASSIC_ENABLED=n

# HTTP server websockets
CONFIG_HTTPD_MAX_REQ_HDR_LEN=1024
CONFIG_HTTPD_WS_SUPPORT=y

# Wi-Fi
CONFIG_APP_WIFI_SOFTAP_SSID="ESP32-HID-Setup"
CONFIG_APP_WIFI_SOFTAP_PASSWORD=""
CONFIG_APP_WIFI_SOFTAP_CHANNEL=6

# Reduce log noise
CONFIG_LOG_DEFAULT_LEVEL_INFO=y

# Build optimization
CONFIG_COMPILER_OPTIMIZATION_SIZE=y
CONFIG_OPTIMIZATION_LEVEL_RELEASE=y
CONFIG_COMPILER_OPTIMIZATION_LEVEL_RELEASE=y
```
